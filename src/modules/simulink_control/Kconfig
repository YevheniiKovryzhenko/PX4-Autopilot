## src/modules/simulink_control/Kconfig
```kconfig
menuconfig MODULES_SIMULINK_CONTROL
	bool "simulink_control"
	default n
	---help---
		Enable support for simulink_control

menuconfig USER_SIMULINK_CONTROL
	bool "simulink_control running as userspace module"
	default n
	depends on BOARD_PROTECTED && MODULES_SIMULINK_CONTROL
	---help---
		Put simulink_control in userspace memory
```

## src/modules/simulink_parameters/Kconfig
```kconfig
menuconfig MODULES_SIMULINK_PARAMETERS
	bool "simulink_parameters"
	default n
	---help---
		Include parameter definitions for the Simulink flight application.
```
